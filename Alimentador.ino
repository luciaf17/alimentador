#include <Arduino.h>
#include <Stepper.h>
#include <Wire.h>
#include <Adafruit_GFX.h>
#include <Adafruit_SSD1306.h>
#include <ESP32Time.h>

//constantes
#define NTP_SERVER "pool.ntp.org"
#define GMT_OFFSET_SEC -3*3600
#define DAYLIGHT_OFFSET_SEC 0
const int stepsPerRevolution = 2048;
#define IN1 19
#define IN2 18
#define IN3 5
#define IN4 17
#define SCREEN_WIDTH 128 // OLED display width, in pixels
#define SCREEN_HEIGHT 64 // OLED display height, in pixels
#define HORA_1 "19"
#define MINUTOS_1 "10"
#define HORA_2 "19"
#define MINUTOS_2 "15"
#define HORA_3 "19"
#define MINUTOS_3 "33"

//metodos
void anti_atasco(int aux);
void alimento();
void atras();

//inicializar
Stepper motor1(stepsPerRevolution, IN1, IN3, IN2, IN4);
ESP32Time rtc;
Adafruit_SSD1306 display(SCREEN_WIDTH, SCREEN_HEIGHT, &Wire, -1);

//imagen gato
const unsigned char PROGMEM gato [] = {
0x00, 0x00, 0x00, 0x00, 0x00, 0x00, 0x00, 0x00, 0x00, 0x00, 0x00, 0x00, 0x00, 0x00, 0x00, 0x00,
0x00, 0x00, 0x00, 0x00, 0x00, 0x00, 0x00, 0x00, 0x00, 0x00, 0x00, 0x00, 0x00, 0x00, 0x00, 0x00,
0x00, 0x00, 0x00, 0x00, 0x00, 0x00, 0x00, 0x00, 0x00, 0x00, 0x00, 0x00, 0x00, 0x00, 0x00, 0x00,
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0x00, 0x00, 0x00, 0x00, 0x00, 0x00, 0x00, 0x00, 0x00, 0x00, 0x00, 0x00, 0x00, 0x00, 0x00, 0x00
};


void setup(){
    //oled
    Serial.begin(115200);

    if(!display.begin(SSD1306_SWITCHCAPVCC, 0x3C)) { // Address 0x3D for 128x64
        Serial.println(F("SSD1306 allocation failed"));
        for(;;);
    }
    delay(1000);
    display.clearDisplay();
    display.display(); 
    delay(1000);
    display.drawBitmap(0,0,gato,128,64,WHITE);
    display.display();
    delay(3000);
    display.clearDisplay();
    display.display(); 
    delay(1000);
    display.setTextSize(1);
    display.setTextColor(WHITE);
    display.setCursor(0, 0);
    display.println("Horarios de alimento");
    display.setCursor(0, 25);
    display.println("Hora 1: " HORA_1 ":" MINUTOS_1);
    display.setCursor(0, 40);
    display.println("Hora 2: " HORA_2 ":" MINUTOS_2);
    display.setCursor(0, 55);
    display.println("Hora 3: " HORA_3 ":" MINUTOS_3);
    display.display(); 
    // set the speed 
    motor1.setSpeed(5);
    //reloj
    configTime(GMT_OFFSET_SEC, DAYLIGHT_OFFSET_SEC, NTP_SERVER);
    struct tm timeinfo;
    if (getLocalTime(&timeinfo)){
        rtc.setTimeStruct(timeinfo);
    }
    
}

void anti_atasco(int aux){
  for(int a = 0; a < aux; a ++){
    motor1.step(150);
    delay(15);
    motor1.step(-50);
    delay(15);
  }

}

void atras()
{
  motor1.step(300);
    
  digitalWrite(IN1, LOW); 
  digitalWrite(IN2, LOW);
  digitalWrite(IN3, LOW);
  digitalWrite(IN4, LOW);

}

void alimento(){
    display.clearDisplay();
    display.setTextSize(1);
    display.setTextColor(WHITE);
    display.setCursor(0, 0);
    // Display text
    display.println("Alimentando al michi");
    display.setCursor(0, 25);
    display.println("Son las: " + rtc.getTime("%H:%M"));
    display.display(); 
    anti_atasco(2);
    for (int aux = 0; aux < 8; aux ++){
        motor1.step(-300);
    anti_atasco(2);
    }
    display.clearDisplay();
    display.display();

  //apago las bobinas
  digitalWrite(IN1, LOW);  
  digitalWrite(IN2, LOW);
  digitalWrite(IN3, LOW);
  digitalWrite(IN4, LOW);
}

void loop(){
    //feed if the hour is
    if (rtc.getTime("%H")== HORA_1 && rtc.getTime("%M")== MINUTOS_1)
        {
            alimento();
            
        }
    if (rtc.getTime("%H")== HORA_2 && rtc.getTime("%M")== MINUTOS_2)
        {
            alimento();
        }
    if (rtc.getTime("%H")== HORA_3 && rtc.getTime("%M")== MINUTOS_3)
        {
            alimento();
            
        }
    delay(1000);
}
